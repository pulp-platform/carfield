// Copyright 2022 ETH Zurich and University of Bologna.
// Solderpad Hardware License, Version 0.51, see LICENSE for details.
// SPDX-License-Identifier: SHL-0.51
//
// Cyril Koenig <cykoenig@iis.ee.ethz.ch>

/dts-v1/;
/ {
  #address-cells = <2>;
  #size-cells = <2>;
  compatible = "eth,carfield-dev";
  model = "eth,carfield";
  chosen {
    stdout-path = "/soc/serial@3002000:38400";
  };

  memory@80000000 {
    // Give 1GiB to Linux management
    device_type = "memory";
    reg = <0x0 0x80000000 0x0 0x40000000>;
  };

  /include/ "carfield_soc.dtsi"

};
